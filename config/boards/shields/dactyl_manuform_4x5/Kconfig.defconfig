## config/boards/shields/dactyl_manuform_4x5/Kconfig.defconfig
```kconfig
if SHIELD_DACTYL_MANUFORM_4x5_LEFT

    config ZMK_KEYBOARD_NAME
        default "Dactyl"

    config ZMK_SPLIT_BLE_ROLE_CENTRAL
        default y
endif

if SHIELD_DACTYL_MANUFORM_4x5_RIGHT

    config ZMK_KEYBOARD_NAME
        default "Dactyl Right"

endif

if SHIELD_DACTYL_MANUFORM_4x5_LEFT || SHIELD_DACTYL_MANUFORM_4x5_RIGHT

    config ZMK_SPLIT
        default y

endif
```
